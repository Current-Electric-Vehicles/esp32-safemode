## firmware/sdkconfig.defaults
```kconfig
# Safemode Default Configuration

# Target
CONFIG_IDF_TARGET="esp32"

# Flash
CONFIG_ESPTOOLPY_FLASHSIZE_8MB=y

# Custom partition table
CONFIG_PARTITION_TABLE_CUSTOM=y
CONFIG_PARTITION_TABLE_CUSTOM_FILENAME="partitions.csv"
CONFIG_PARTITION_TABLE_OFFSET=0x10000

# Tolerate partition tables without MD5 (safemode runs on other devices)
CONFIG_PARTITION_TABLE_MD5=n

# Compiler — optimize for size
CONFIG_COMPILER_OPTIMIZATION_SIZE=y
# CONFIG_COMPILER_CXX_EXCEPTIONS is not set
# CONFIG_COMPILER_CXX_RTTI is not set

# Logging
CONFIG_LOG_DEFAULT_LEVEL_INFO=y

# Bootloader log level
CONFIG_BOOTLOADER_LOG_LEVEL_WARN=y
CONFIG_BOOTLOADER_COMPILER_OPTIMIZATION_SIZE=y

# FreeRTOS
CONFIG_FREERTOS_HZ=1000

# Watchdog
CONFIG_ESP_TASK_WDT_TIMEOUT_S=10

# Panic handler
CONFIG_ESP_SYSTEM_PANIC_PRINT_HALT=y

# HTTP server
CONFIG_HTTPD_MAX_URI_HANDLERS=16
# CONFIG_HTTPD_WS_SUPPORT is not set

# LWIP — NOTE: LWIP_NETIF_LOOPBACK must stay enabled (HTTP server needs it)
CONFIG_LWIP_MAX_SOCKETS=8
# CONFIG_LWIP_IPV6 is not set
# CONFIG_LWIP_SNTP is not set
# CONFIG_LWIP_AUTOIP is not set
# CONFIG_LWIP_DHCP_DOES_ARP_CHECK is not set
# CONFIG_LWIP_DHCP_RESTORE_LAST_IP is not set
# CONFIG_LWIP_TCP_KEEPALIVE is not set

# WiFi — AP mode with WPA2-PSK only, no extras
CONFIG_ESP_WIFI_SOFTAP_SUPPORT=y
# CONFIG_ESP_WIFI_SOFTAP_SAE_SUPPORT is not set
# CONFIG_ESP_WIFI_ENTERPRISE_SUPPORT is not set
# CONFIG_ESP_WIFI_FTM_ENABLE is not set
# CONFIG_ESP_WIFI_GMAC_SUPPORT is not set
# CONFIG_ESP_WIFI_11KV_SUPPORT is not set
# CONFIG_ESP_WIFI_MBO_SUPPORT is not set
# CONFIG_ESP_WIFI_DPP_SUPPORT is not set
# CONFIG_ESP_WIFI_11R_SUPPORT is not set
# CONFIG_ESP_WIFI_WPS_SOFTAP_REGISTRAR is not set
# CONFIG_ESP_WIFI_WAPI_PSK is not set
# CONFIG_ESP_WIFI_NAN_ENABLE is not set
# CONFIG_ESP_WIFI_ENABLE_ROAMING_APP is not set
CONFIG_ESP_WIFI_STATIC_RX_BUFFER_NUM=4
CONFIG_ESP_WIFI_DYNAMIC_RX_BUFFER_NUM=8

# mbedTLS — strip unused features (TLS APIs stay so esp-tls compiles)
# CONFIG_MBEDTLS_CERTIFICATE_BUNDLE is not set
# CONFIG_MBEDTLS_PKCS7_C is not set
# CONFIG_MBEDTLS_SELF_TEST is not set
# CONFIG_MBEDTLS_ERROR_STRINGS is not set
# CONFIG_MBEDTLS_HAVE_TIME is not set
# CONFIG_MBEDTLS_HAVE_TIME_DATE is not set
# CONFIG_MBEDTLS_FS_IO is not set
# CONFIG_MBEDTLS_HKDF_C is not set
# CONFIG_MBEDTLS_SSL_KEEP_PEER_CERTIFICATE is not set
# CONFIG_MBEDTLS_SSL_RENEGOTIATION is not set
# CONFIG_MBEDTLS_SSL_ALPN is not set
# CONFIG_MBEDTLS_CLIENT_SSL_SESSION_TICKETS is not set
# CONFIG_MBEDTLS_SERVER_SSL_SESSION_TICKETS is not set
# CONFIG_MBEDTLS_KEY_EXCHANGE_RSA is not set
# CONFIG_MBEDTLS_ECP_DP_BP256R1_ENABLED is not set
# CONFIG_MBEDTLS_ECP_DP_BP384R1_ENABLED is not set
# CONFIG_MBEDTLS_ECP_DP_BP512R1_ENABLED is not set
# CONFIG_MBEDTLS_ECP_DP_CURVE25519_ENABLED is not set
# CONFIG_MBEDTLS_ECP_DP_SECP256K1_ENABLED is not set
# CONFIG_MBEDTLS_ECP_DP_SECP384R1_ENABLED is not set
# CONFIG_MBEDTLS_ECP_DP_SECP521R1_ENABLED is not set

# Disable unused subsystems
# CONFIG_VFS_SUPPORT_DIR is not set
# CONFIG_VFS_SUPPORT_TERMIOS is not set
# CONFIG_ESP_ERR_TO_NAME_LOOKUP is not set

# Use newlib nano for smaller printf
CONFIG_NEWLIB_NANO_FORMAT=y

# Bluetooth — NimBLE host, BLE only, peripheral role
CONFIG_BT_ENABLED=y
CONFIG_BT_NIMBLE_ENABLED=y
CONFIG_BT_CONTROLLER_ENABLED=y
CONFIG_BT_NIMBLE_ROLE_PERIPHERAL=y
# CONFIG_BT_NIMBLE_ROLE_CENTRAL is not set
# CONFIG_BT_NIMBLE_ROLE_BROADCASTER is not set
# CONFIG_BT_NIMBLE_ROLE_OBSERVER is not set
CONFIG_BT_NIMBLE_MAX_CONNECTIONS=1
CONFIG_BT_NIMBLE_GAP_DEVICE_NAME="safemode"
# MAX_BONDS=0 triggers -Werror=array-bounds in ESP-IDF 5.x; use 1 instead.
# Bonding/security is disabled so the array is allocated but never populated.
CONFIG_BT_NIMBLE_MAX_BONDS=1
CONFIG_BT_NIMBLE_MAX_CCCDS=1
# CONFIG_BT_NIMBLE_SECURITY_ENABLE is not set
# CONFIG_BT_NIMBLE_SM_LEGACY is not set
# CONFIG_BT_NIMBLE_SM_SC is not set
# CONFIG_BT_NIMBLE_NVS_PERSIST is not set
# CONFIG_BT_NIMBLE_EXT_ADV is not set
# CONFIG_BT_NIMBLE_BLE_GATT_CACHING is not set
# CONFIG_BT_NIMBLE_50_FEATURE_SUPPORT is not set
# CONFIG_BT_NIMBLE_WHITELIST_API is not set
# CONFIG_BT_NIMBLE_HCI_VS is not set
# CONFIG_BT_NIMBLE_BLE_POWER_CONTROL is not set
CONFIG_BT_NIMBLE_LOG_LEVEL_NONE=y
CONFIG_BT_NIMBLE_ATT_PREFERRED_MTU=128
CONFIG_BT_CTRL_MODE_EFF=1
CONFIG_BT_CTRL_BLE_MAX_ACT=2

# Heap & assertions
CONFIG_HEAP_TLSF_USE_ROM_IMPL=y
# CONFIG_HEAP_POISONING_LIGHT is not set
# CONFIG_HEAP_POISONING_COMPREHENSIVE is not set
# CONFIG_HEAP_TASK_TRACKING is not set

# Disable debug subsystems we don't need
# CONFIG_FREERTOS_USE_TRACE_FACILITY is not set
# CONFIG_FREERTOS_GENERATE_RUN_TIME_STATS is not set
# CONFIG_ESP_DEBUG_STUBS_ENABLE is not set
# CONFIG_ESP_GDBSTUB_ENABLED is not set
# CONFIG_ESP_COREDUMP_ENABLE is not set
```
